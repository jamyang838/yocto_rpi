## build_gatesgarth/conf/bblayers.conf
```bitbake
# POKY_BBLAYERS_CONF_VERSION is increased each time build/conf/bblayers.conf
# changes incompatibly
POKY_BBLAYERS_CONF_VERSION = "2"

BBPATH = "${TOPDIR}"
BBFILES ?= ""

BBLAYERS ?= " \
  /home/yang/yocto/gatesgarth/poky/meta \
  /home/yang/yocto/gatesgarth/poky/meta-poky \
  /home/yang/yocto/gatesgarth/poky/meta-yocto-bsp \
  /home/yang/yocto/gatesgarth/poky/meta-raspberrypi \
  /home/yang/yocto/gatesgarth/poky/meta-openembedded/meta-oe \
  /home/yang/yocto/gatesgarth/poky/meta-openembedded/meta-python \
  /home/yang/yocto/gatesgarth/poky/meta-openembedded/meta-networking \
  /home/yang/yocto/m2_sumo/meta-m2rpi4 \
  "
```

## build_gatesgarth/conf/local.conf
```bitbake
#MACHINE ?= "qemuarm"
#MACHINE ?= "qemuarm64"
#MACHINE ?= "qemumips"
#MACHINE ?= "qemumips64"
#MACHINE ?= "qemuppc"
#MACHINE ?= "qemux86"
#MACHINE ?= "qemux86-64"

#MACHINE ?= "beaglebone-yocto"
#MACHINE ?= "genericx86"
#MACHINE ?= "genericx86-64"
#MACHINE ?= "edgerouter"

MACHINE ??= "raspberrypi4_m2"

#DISTRO ?= "poky"
DISTRO ?= "example-distro"
PACKAGE_CLASSES ?= "package_rpm"

#  "dbg-pkgs"       - add -dbg packages for all installed packages
#                     (adds symbol information for debugging/profiling)
#  "src-pkgs"       - add -src packages for all installed packages
#                     (adds source code for debugging)
#  "dev-pkgs"       - add -dev packages for all installed packages
#                     (useful if you want to develop against libs in the image)
#  "ptest-pkgs"     - add -ptest packages for all ptest-enabled packages
#                     (useful if you want to run the package test suites)
#  "tools-sdk"      - add development tools (gcc, make, pkgconfig etc.)
#  "tools-debug"    - add debugging tools (gdb, strace)
#  "eclipse-debug"  - add Eclipse remote debugging support
#  "tools-profile"  - add profiling tools (oprofile, lttng, valgrind)
#  "tools-testapps" - add useful testing tools (ts_print, aplay, arecord etc.)
#  "debug-tweaks"   - make an image suitable for development
#                     e.g. ssh root access has a blank password
EXTRA_IMAGE_FEATURES ?= "debug-tweaks tools-debug"

USER_CLASSES ?= "buildstats image-mklibs image-prelink"

PATCHRESOLVE = "noop"

BB_DISKMON_DIRS ??= "\
    STOPTASKS,${TMPDIR},1G,100K \
    STOPTASKS,${DL_DIR},1G,100K \
    STOPTASKS,${SSTATE_DIR},1G,100K \
    STOPTASKS,/tmp,100M,100K \
    ABORT,${TMPDIR},100M,1K \
    ABORT,${DL_DIR},100M,1K \
    ABORT,${SSTATE_DIR},100M,1K \
    ABORT,/tmp,10M,1K"

PACKAGECONFIG_append_pn-qemu-system-native = " sdl"

CONF_VERSION = "1"
```

## build_sumo_deploy/conf/bblayers.conf
```bitbake
# POKY_BBLAYERS_CONF_VERSION is increased each time build/conf/bblayers.conf
# changes incompatibly
POKY_BBLAYERS_CONF_VERSION = "2"

BBPATH = "${TOPDIR}"
BBFILES ?= ""

BBLAYERS ?= " \
  /home/yang/yocto/sumo/poky/meta \
  /home/yang/yocto/sumo/poky/meta-poky \
  /home/yang/yocto/sumo/poky/meta-yocto-bsp \
  /home/yang/yocto/sumo/poky/meta-raspberrypi \
  /home/yang/yocto/sumo/poky/meta-qt5 \
  /home/yang/yocto/sumo/poky/meta-openembedded/meta-oe \
  /home/yang/yocto/sumo/poky/meta-openembedded/meta-python \
  /home/yang/yocto/m2_poky/meta-m2 \
  /home/yang/yocto/sumo/poky/meta-openembedded/meta-networking \
  "
```

## example/build/conf/bblayers.conf
```bitbake
# POKY_BBLAYERS_CONF_VERSION is increased each time build/conf/bblayers.conf
# changes incompatibly
POKY_BBLAYERS_CONF_VERSION = "2"

BBPATH = "${TOPDIR}"
BBFILES ?= ""

BBLAYERS ?= " \
  /home/yang/yocto2/poky/meta \
  /home/yang/yocto2/poky/meta-poky \
  /home/yang/yocto2/poky/meta-yocto-bsp \
  /home/yang/yocto2/poky/meta-raspberrypi \
  /home/yang/yocto2/poky/meta-qt5 \
  /home/yang/yocto2/poky/meta-hubshuffle \
  /home/yang/yocto2/poky/meta-openembedded/meta-oe \
  /home/yang/yocto2/poky/meta-openembedded/meta-python \
  /home/yang/yocto2/poky/meta-openembedded/meta-networking \
  "
```

## meta-hubshuffle/conf/layer.conf
```bitbake
# We have a conf and classes directory, add to BBPATH
BBPATH .= ":${LAYERDIR}"

# We have recipes-* directories, add to BBFILES
BBFILES += "${LAYERDIR}/recipes-*/*/*.bb \
            ${LAYERDIR}/recipes-*/*/*.bbappend"

BBFILE_COLLECTIONS += "meta-hubshuffle"
BBFILE_PATTERN_meta-hubshuffle = "^${LAYERDIR}/"
BBFILE_PRIORITY_meta-hubshuffle = "6"

LAYERDEPENDS_meta-hubshuffle = "core"
#LAYERSERIES_COMPAT_meta-hubshuffle = "dunfell"
LAYERSERIES_COMPAT_meta-hubshuffle = "sumo"
```

## meta-m2/conf/distro/example-distro.conf
```bitbake
MAINTAINER = "yang <yang140@itri.org.tw>"

require conf/distro/poky.conf
DISTRO = "example-distro"
DISTRO_NAME = "M2"
DISTRO_VERSION = "1.0"
DISTRO_CODENAME = "M2-distro"
SDK_VENDOR = "-exampledistro"
SDK_VERSION = "sdkversion"

hostname_pn-base-files = "m200"
#Replace sysv with systemd
DISTRO_FEATURES += "systemd"
VIRTUAL-RUNTIME_init_manager = "systemd"
DISTRO_FEATURES_remove += "sysvinit"
VIRTUAL-RUNTIME_initscripts = "systemd-compat-units"
DISTRO_FEATURES_BACKFILL_CONSIDERED += "sysvinit"

#Remove unneeded features
DISTRO_FEATURES += "opengl"
DISTRO_FEATURES_remove += "bluetooth ext2 irda pcmcia pci 3g nfc x11 multiarch wayland vulkan pulseaudio bluez5"
```

## meta-m2/conf/layer.conf
```bitbake
# We have a conf and classes directory, add to BBPATH
BBPATH .= ":${LAYERDIR}"

# We have recipes-* directories, add to BBFILES
BBFILES += "${LAYERDIR}/recipes-*/*/*.bb \
            ${LAYERDIR}/recipes-*/*/*.bbappend"

BBFILE_COLLECTIONS += "meta-m2"
BBFILE_PATTERN_meta-m2 = "^${LAYERDIR}/"
BBFILE_PRIORITY_meta-m2 = "6"

LAYERDEPENDS_meta-m2= "core"
LAYERSERIES_COMPAT_meta-m2 = "sumo"
```

## meta-m2/conf/machine/raspberrypi3_custom3.conf
```bitbake
#@TYPE: Machine
#@NAME: RaspberryPi 3 Development Board (32bit)
#@DESCRIPTION: Machine configuration for the RaspberryPi 3 in 32 bits mode

MACHINEOVERRIDES =. "raspberrypi3:"

DEFAULTTUNE ?= "cortexa7thf-neon-vfpv4"
require conf/machine/include/tune-cortexa7.inc
include conf/machine/include/rpi-base.inc

MACHINE_EXTRA_RRECOMMENDS += "\
    linux-firmware-rpidistro-bcm43430 \
    linux-firmware-rpidistro-bcm43455 \
    bluez-firmware-rpidistro-bcm43430a1-hcd \
    bluez-firmware-rpidistro-bcm4345c0-hcd \
"

SDIMG_KERNELIMAGE ?= "kernel7.img"
UBOOT_MACHINE = "rpi_3_32b_config"
SERIAL_CONSOLES ?= "115200;ttyS0"

ENABLE_UART = "1"
ENABLE_I2C = "1"
ENABLE_SPI_BUS = "1"
GPU_MEM = "256"
DISABLE_SPLASH = "1"
DISABLE_RPI_BOOT_LOGO = "1"

KERNEL_MODULE_AUTOLOAD += "i2c-dev"

VC4DTBO ?= "vc4-fkms-v3d"
ARMSTUB ?= "armstub7.bin"
```

## meta-m2/conf/machine/raspberrypi3_sumo.conf
```bitbake
#@TYPE: Machine
#@NAME: RaspberryPi 3 Development Board
#@DESCRIPTION: Machine configuration for the RaspberryPi 3
MACHINEOVERRIDES =. "raspberrypi3:"
DEFAULTTUNE ?= "cortexa7thf-neon-vfpv4"
require conf/machine/include/tune-cortexa7.inc
include conf/machine/include/rpi-base.inc

MACHINE_EXTRA_RRECOMMENDS += "\
    linux-firmware-bcm43430 \
    linux-firmware-bcm43455 \
    linux-firmware-bcm43430a1-hcd \
    linux-firmware-bcm4345c0-hcd \
"
SDIMG_KERNELIMAGE ?= "kernel7.img"
UBOOT_MACHINE = "rpi_3_32b_config"
SERIAL_CONSOLE ?= "115200 ttyS0"

ENABLE_UART = "1"
ENABLE_I2C = "1"
ENABLE_SPI_BUS = "1"
GPU_MEM = "256"
DISABLE_SPLASH = "1"
DISABLE_RPI_BOOT_LOGO = "1"

KERNEL_MODULE_AUTOLOAD += "i2c-dev"

VC4_CMA_SIZE ?= "cma-256"
```

## meta-m2rpi4/conf/layer.conf
```bitbake
# We have a conf and classes directory, add to BBPATH
BBPATH .= ":${LAYERDIR}"

# We have recipes-* directories, add to BBFILES
BBFILES += "${LAYERDIR}/recipes-*/*/*.bb \
            ${LAYERDIR}/recipes-*/*/*.bbappend"

BBFILE_COLLECTIONS += "meta-m2rpi4"
BBFILE_PATTERN_meta-m2rpi4 = "^${LAYERDIR}/"
BBFILE_PRIORITY_meta-m2rpi4 = "6"

LAYERDEPENDS_meta-m2rpi4 = "core"
LAYERSERIES_COMPAT_meta-m2rpi4 = "gatesgarth"
```

## meta-m2rpi4/conf/machine/raspberrypi4_m2.conf
```bitbake
#@TYPE: Machine
#@NAME: RaspberryPi 3 Development Board
#@DESCRIPTION: Machine configuration for the RaspberryPi 3
MACHINEOVERRIDES =. "raspberrypi4:"
DEFAULTTUNE ?= "cortexa7thf-neon-vfpv4"
require conf/machine/include/tune-cortexa7.inc
include conf/machine/include/rpi-base.inc

MACHINE_FEATURES += "pci"
MACHINE_EXTRA_RRECOMMENDS += "\
    linux-firmware-rpidistro-bcm43455 \
    bluez-firmware-rpidistro-bcm4345c0-hcd \
"

# 'l' stands for LPAE
SDIMG_KERNELIMAGE ?= "kernel7l.img"
UBOOT_MACHINE = "rpi_4_32b_config"
SERIAL_CONSOLES ?= "115200;ttyS0"


ENABLE_UART = "1"
ENABLE_I2C = "1"
ENABLE_SPI_BUS = "1"
GPU_MEM = "256"
DISABLE_SPLASH = "1"
DISABLE_RPI_BOOT_LOGO = "1"

KERNEL_MODULE_AUTOLOAD += "i2c-dev"

VC4DTBO ?= "vc4-fkms-v3d"
ARMSTUB ?= "armstub7.bin"
```
